/* Раскладка образа, который запускает чужой загрузчик.
 *
 * Адрес задан числом, а не оставлен на усмотрение компоновщика, и это главное
 * решение этого файла. Ядро системы собирается позиционно-независимым, потому
 * что наш UEFI-загрузчик умеет применять релокации; заводскому загрузчику
 * телефона про них неизвестно ничего. Значит либо стуб применяет их сам, либо
 * образ линкуется туда, куда его положат. Для первого опыта верно второе:
 * проверяется вход, а не размещение, и лишняя неизвестная здесь ни к чему.
 *
 * 0x40080000 — это начало ОЗУ (0x40000000) плюс общепринятое смещение ядра в
 * восемь мегабайт... нет, 512 КиБ: ровно туда кладёт образ `-kernel` у QEMU
 * `virt`, и оттуда же стартуют ядра на MT676x, у которых ОЗУ начинается с того
 * же адреса. Совпадение не случайно: обе машины следуют одному договору.
 */
ENTRY(_bare_start)

SECTIONS
{
    . = 0x40080000;

    /* Заголовок обязан лежать в самом начале образа: чужой загрузчик читает
     * его по нулевому смещению файла. KEEP — потому что на секцию никто не
     * ссылается, и без него компоновщик выбросил бы её как мусор. */
    .text : {
        KEEP(*(.text.boot))
        *(.text .text.*)
    }
    .rodata : { *(.rodata .rodata.*) }
    .data   : { *(.data .data.*) }

    /* Нули не хранятся в файле, их наводит стуб. Границы выровнены по восьми
     * байтам: очистка идёт словами, и хвост в один байт означал бы либо запись
     * мимо, либо неочищенный остаток. */
    . = ALIGN(8);
    __bss_start = .;
    .bss : { *(.bss .bss.*) *(COMMON) }
    . = ALIGN(8);
    __bss_end = .;

    /* Стек — за образом. Своего у нас нет: загрузчик оставляет указатель
     * неизвестно где, а на телефоне — в памяти, которую он же и переиспользует. */
    . = ALIGN(4096);
    . += 0x4000;
    __stack_top = .;

    __image_end = .;

    /DISCARD/ : { *(.comment) *(.note*) *(.eh_frame*) }
}
