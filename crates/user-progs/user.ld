/* Раскладка пользовательской программы.
 *
 * Адрес загрузки фиксирован и одинаков на обеих архитектурах — 512 ГиБ. Это не
 * произвольное число: и на x86-64, и на AArch64 младшая половина адресного
 * пространства уже занята ядром (образ ядра исполняется identity-отображённым,
 * рядом лежит отображение всей физической памяти), и всё это помещается в
 * первую запись корневой таблицы, покрывающую первые 512 ГиБ. Вторая запись
 * свободна — программа живёт в ней.
 *
 * Секции разведены по страницам намеренно. Ядро отображает каждую страницу с
 * правами того сегмента, которому она принадлежит, и отказывается отображать
 * страницу одновременно записываемой и исполняемой. Код и данные, попавшие в
 * одну страницу, сделали бы такую страницу неизбежной.
 *
 * Имена секций перечислены дважды, с приставкой `l` и без неё, и это не
 * избыточность. На x86-64 программа собирается с большой моделью кода, а в ней
 * компилятор кладёт всё в `.ltext`, `.lrodata`, `.lbss` — шаблон `.text*`
 * такую секцию не ловит. Не пойманная сценарием секция становится «сиротой», и
 * раскладывает её компоновщик по своим правилам: в оптимизированной сборке
 * `.lrodata` и `.lbss` оказывались на одной странице с кодом, то есть страница
 * выходила записываемой и исполняемой сразу, и ядро отказывалось загружать
 * такую программу. Оно было право — виноват был сценарий.
 *
 * Выравнивание задаётся **атрибутом секции** (`.rodata ALIGN(0x1000) :`), а не
 * только присваиванием `. = ALIGN(0x1000)` перед ней. Разница не косметическая:
 * присваивание двигает счётчик адресов, но компоновщик вправе положить секцию
 * по её собственному выравниванию, и в оптимизированной сборке он так и делал —
 * сегменты выходили с адресами вроде 0x175bb, деля страницу с соседями. Ядро
 * отказывалось загружать такую программу словами «страница была бы записываемой
 * и исполняемой одновременно», и было право.
 *
 * Сценарий один на два вида сборки (ASLR, часть вторая). Программа на Rust
 * компонуется позиционно-независимой (`-pie`, с `--defsym=__freeos_pie=1`) —
 * от адреса 0, и ядро кладёт её по случайному адресу внутри окна; программа на
 * C, пока её библиотеки собраны без PIC, — по-прежнему по адресу 512 ГиБ. Два
 * сценария разъехались бы молча, поэтому разница — одно условие в начале.
 */

ENTRY(_start)

/* Эталон канарейки стека. Компилятор (и rustc с `-Z stack-protector`, и clang с
 * `-fstack-protector`) читает его по символу `__stack_chk_guard`, а лежит он в
 * странице процесса — странице только на чтение, которую ядро отображает
 * каждой программе по этому адресу и заполняет случайными байтами до входа в
 * неё. Программа ничего не инициализирует: к её первой функции значение уже на
 * месте. Число повторяет `user_abi::PROCESS_PAGE`; расхождение ловит тест
 * `linker_script_points_the_stack_guard_at_the_process_page` рядом с константой.
 *
 * Символ абсолютный, и это годится обеим архитектурам: на x86-64 большая
 * модель кода берёт его 64-битным адресом, на AArch64 `adrp` дотягивается до
 * него от кода программы — между ними полтора гигабайта при пределе в четыре. */
__stack_chk_guard = 0x0000008060c00000;

SECTIONS
{
    . = DEFINED(__freeos_pie) ? 0 : 0x0000008000000000;

    /* Начало образа. Стартовый код программы, собранной как PIE, берёт этот
     * адрес относительно счётчика команд и так узнаёт, куда ядро её положило
     * (см. `__freeos_entry` в `user_progs`). */
    __image_base = .;

    .text : ALIGN(0x1000) {
        *(.text._start)
        *(.ltext._start)
        *(.text .text.*)
        *(.ltext .ltext.*)
    }

    . = ALIGN(0x1000);
    .rodata ALIGN(0x1000) : {
        *(.rodata .rodata.*)
        *(.lrodata .lrodata.*)
    }

    /* Таблицы, которые оставляет `-pie`: перемещения и то, чем их находят.
     * Читаются только стартовым кодом — страницы только на чтение. Названы
     * явно: секция-«сирота» легла бы по правилам компоновщика, и однажды это
     * уже дало страницу, записываемую и исполняемую сразу. */
    .rela.dyn : { *(.rela.dyn .rela.*) }
    .dynsym : { *(.dynsym) }
    .dynstr : { *(.dynstr) }
    .hash : { *(.hash) }
    .gnu.hash : { *(.gnu.hash) }

    . = ALIGN(0x1000);
    .data ALIGN(0x1000) : {
        *(.data .data.*)
        *(.ldata .ldata.*)
        *(.got .got.plt)
    }

    /* То, что в позиционно-независимой программе содержит адреса и потому
     * перемещается при старте: таблицы виртуальных функций, строки в
     * таблицах, указатели. Лежит в записываемом сегменте — стартовый код
     * пишет сюда, а защищать его потом на чтение (RELRO) пока некому. */
    .data.rel.ro : { *(.data.rel.ro .data.rel.ro.*) }
    .dynamic : { *(.dynamic) }

    /* `.bss` живёт в том же сегменте, что и `.data`: оба доступны на запись, и
     * разводить их по страницам незачем — разделять надо права, а не имена. */
    .bss ALIGN(0x10) : {
        *(.bss .bss.*)
        *(.lbss .lbss.*)
        *(COMMON)
    }

    /* Всё, что не нужно на исполнении: отладочная информация, таблицы
     * раскрутки стека, комментарии компилятора. Оставленные в образе, они
     * попали бы в сегменты и потребовали бы страниц. */
    /DISCARD/ : {
        *(.eh_frame)
        *(.eh_frame_hdr)
        *(.comment)
        *(.note .note.*)
    }
}
