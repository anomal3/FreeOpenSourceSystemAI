/* Раскладка ядра для чужого загрузчика: фиксированный адрес вместо PIE.
 *
 * # Почему не так, как везде
 *
 * Обычная сборка ядра — позиционно-независимая (см. `.cargo/config.toml`):
 * наш UEFI-загрузчик сам выделяет память и сам применяет релокации из
 * `.rela.dyn`. Заводскому загрузчику телефона про релокации неизвестно ничего:
 * он кладёт образ по адресу из своего заголовка и переходит на первый байт.
 *
 * Значит, вариантов ровно два: либо ядро правит себя само, разбирая
 * `.rela.dyn` **до** включения MMU, без кучи и без гарантий стека, — либо оно
 * линкуется туда, куда его положат. Выбрано второе, и выбрано сознательно:
 * ошибка в саморелокации не даёт ни строки, ни признака, а машина при этом
 * исправно крутится. Ровно такой отказ (текстовое смещение в заголовке, не
 * совпавшее с адресом компоновки) уже стоил дня работы на `boot-bare`.
 *
 * Путь UEFI это не трогает: здесь вторая сборка того же крейта, а не замена
 * первой.
 *
 * # Про число 0x40080000
 *
 * Начало ОЗУ (0x40000000) плюс смещение ядра 0x80000. Оба совпадают у QEMU
 * `virt` и у MT676x, и это не совпадение: обе машины следуют одному договору.
 * То же число стоит в заголовке образа (`text_offset` в `head_fdt.S`) и в
 * заголовке Android boot image, который собирает `xtask phone`. Разъехаться им
 * нельзя — три записи одного адреса сверяются сборкой.
 */
ENTRY(_phone_start)

SECTIONS
{
    . = 0x40080000;
    __image_start = .;
    __text_start = .;

    /* Заголовок обязан лежать в самом первом байте файла: загрузчик читает его
     * по нулевому смещению. KEEP — на секцию никто не ссылается, и без него
     * компоновщик выбросил бы её как мусор. */
    .text : {
        KEEP(*(.text.boot))
        *(.text .text.*)
    }
    . = ALIGN(4096);
    __text_end = .;

    __rodata_start = .;
    .rodata : { *(.rodata .rodata.*) }
    . = ALIGN(4096);
    __rodata_end = .;

    __data_start = .;
    .data : { *(.data .data.*) }
    .got  : { *(.got .got.plt) }

    /* Нули в файле не хранятся, их наводит вход. Границы выровнены по восьми
     * байтам: очистка идёт словами, и хвост в один байт означал бы либо запись
     * мимо конца, либо неочищенный остаток — то есть статическую переменную,
     * набитую тем, что лежало в этой памяти до нас. */
    . = ALIGN(8);
    __bss_start = .;
    .bss : { *(.bss .bss.*) *(COMMON) }
    . = ALIGN(8);
    __bss_end = .;
    . = ALIGN(4096);
    __data_end = .;

    /* Стек. Свой, а не оставленный загрузчиком: чужой указатель показывает в
     * память, которую тот же загрузчик считает своей и вправе переиспользовать.
     * Живёт он недолго — до `switch_stack` на стек ядра, — но на нём успевает
     * отработать разбор дерева, распределитель кадров и построение таблиц. */
    . = ALIGN(4096);
    . += 0x20000;
    __stack_top = .;

    /* Конец образа — вместе со стеком: это число уезжает в заголовок как
     * `image_size`, и по нему загрузчик решает, куда положить дерево
     * устройств. Занизить его значит получить дерево под собственным стеком. */
    __image_end = .;

    /DISCARD/ : {
        *(.comment)
        *(.note*)
        *(.eh_frame*)
        *(.interp)
        *(.dynamic)
        *(.dynsym)
        *(.dynstr)
        *(.hash)
        *(.gnu.hash)
    }
}
